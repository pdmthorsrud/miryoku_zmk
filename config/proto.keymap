// Copyright 2021 Manna Harbour
// https://github.com/manna-harbour/miryoku

#include "../miryoku/custom_config.h"
#include "../miryoku/mapping/34/proto.h"
#include "../miryoku/miryoku.dtsi"


/ {
    combos {
        compatible = "zmk,combos";
        combo_oe {
            timeout-ms = <50>;
            key-positions = <7 8>;
            bindings = <&kp SEMI>;
        };
        combo_ae {
            timeout-ms = <50>;
            key-positions = <8 9>;
            bindings = <&kp SEMI>;
        };
    };
};
